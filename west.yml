## zephyr/Kconfig
```kconfig
# Copyright (c) 2026 Alexander Wachter
#
# SPDX-License-Identifier: Apache-2.0

config MTL
	bool "mtl template library"
	select CPP
	select REQUIRES_FULL_LIBCPP
	help
	  Enable the mtl header-only library (template-based state machine,
	  typelists, units) and its Zephyr glue: timer policies for fsm::timed
	  and the transition trace logger. Needs C++20 or later
	  (CONFIG_STD_CPP20).

if MTL

config MTL_FSM_WORKQUEUE_STACK_SIZE
	int "Stack size of a state machine's own workqueue"
	default 2048
	help
	  mtl::zephyr::StateMachine drains its events on a workqueue thread
	  of its own unless it is given a shared mtl::zephyr::WorkQueue.
	  The stack runs every hook of the machine's observers, their
	  logging included.

config MTL_FSM_WORKQUEUE_PRIORITY
	int "Priority of a state machine's own workqueue"
	default 5
	help
	  Thread priority of the workqueue an mtl::zephyr::StateMachine
	  owns; negative priorities are cooperative.

config MTL_FSM_EVENT_BUFFER_CAPACITY
	int "Capacity of a state machine's event buffer"
	default 4
	range 1 255
	help
	  Events an mtl::zephyr::StateMachine holds until its workqueue
	  delivers them: size it for the worst burst of events
	  arriving before the workqueue gets to run. Timer expiries do not
	  take a slot. An event arriving on a full FIFO is lost and
	  process() returns false.

config MTL_FSM_TRACE
	bool "Trace state machine transitions"
	depends on LOG
	help
	  Provide mtl::zephyr::TraceLogger, an observer logging every
	  transition of the state machine it is injected into on the mtl_fsm
	  log module, in the fsm::tracing line grammar read by tools/fsmview:
	    fsm[<machine>] -> <state>
	    fsm[<machine>] <from> -(<event>)-> <to>
	  The lines are emitted at info level; below that level the observer
	  compiles to nothing, name strings included.

if MTL_FSM_TRACE

module = MTL_FSM
module-str = mtl state machine trace
source "subsys/logging/Kconfig.template.log_config"

endif # MTL_FSM_TRACE

endif # MTL
```

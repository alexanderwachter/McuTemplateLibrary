## CMakeLists.txt
```
# Copyright (c) 2026 Alexander Wachter
#
# SPDX-License-Identifier: Apache-2.0

cmake_minimum_required(VERSION 3.21)

# The library is the module providing mtl::zephyr; point Zephyr at it
# when it is not in the west manifest
set(MTL_ROOT ${CMAKE_CURRENT_LIST_DIR}/../../..)
list(APPEND ZEPHYR_EXTRA_MODULES ${MTL_ROOT})

find_package(Zephyr REQUIRED HINTS $ENV{ZEPHYR_BASE})
project(mtl_sensor LANGUAGES CXX)

target_sources(app PRIVATE src/main.cpp)

# "west build -t dot" writes the graphs into the build directory for
# tools/fsmview: led_table, sensor_table (every feature in view - the
# machine leaves the disabled ones out, the graph shows the whole
# table) and measuring_table, all from the crawl
add_custom_target(dot
    COMMAND ${PYTHON_EXECUTABLE} ${MTL_ROOT}/tools/dotgen/dotgen.py
            ${CMAKE_CURRENT_LIST_DIR}/src/led.hpp ${CMAKE_CURRENT_LIST_DIR}/src/sensor.hpp
            -o ${CMAKE_BINARY_DIR}/dot
    COMMENT "Writing the state machine graphs into ${CMAKE_BINARY_DIR}/dot"
    VERBATIM
)
```

## Kconfig
```
# Copyright (c) 2026 Alexander Wachter
#
# SPDX-License-Identifier: Apache-2.0

mainmenu "Sensor monitor sample"

config SAMPLE_CALIBRATION
	bool "Calibrate the sensor at start"
	default y
	help
	  Inject the calibrator observer. The sensor machine's table then
	  starts in the calibrating state, which the observer answers with
	  calibrated{offset}; without it the table has no such state.

source "Kconfig.zephyr"
```

## prj.conf
```kconfig
CONFIG_MTL=y
CONFIG_MTL_FSM_TRACE=y
CONFIG_STD_CPP20=y
CONFIG_LOG=y
CONFIG_GPIO=y
CONFIG_LOG_PROCESS_THREAD_SLEEP_MS=50
```

## src/main.cpp
```c
/*
 * Sensor monitor: a tour of the state machine's features on a Zephyr
 * board. The tables live in sensor.hpp and led.hpp (Zephyr-free, for
 * the graph generator); this file provides the observers:
 *
 *   VirtualSensor  - starts a "conversion" when the reading state is
 *                     entered (a delayed work - reading is a sub-state of
 *                     measuring, the hook gets the submachine) and injects
 *                     reading_done{value} or reading_failed when it finishes
 *   Calibrator      - the calibration feature: when injected, the table
 *                     gains the calibrating state, which it answers with
 *                     calibrated{offset} (CONFIG_SAMPLE_CALIBRATION)
 *   AlarmPolicy     - answers the table's above_limit guard from a
 *                     runtime limit: a guard injected like an observer
 *   LedController  - picks the led_pattern element of each state's
 *                     annotation set and drives its own LED state machine
 *                     (the sub machine is an observer of the sensor machine)
 *   PowerRail      - picks the sensor_power element of the same sets
 *   LedDriver      - value observer of the LED machine writing led0
 *   TraceLogger     - both machines trace to the mtl_fsm log module
 *
 * Both machines are mtl::zephyr::StateMachineOnSharedWorkqueue, each
 * one declaration: a queued machine with its own timeout timer,
 * process() only queues, and both drain on one mtl::zephyr::WorkQueue
 * (the plain mtl::zephyr::StateMachine owns a workqueue thread instead).
 * Every event source may therefore process() from where it is - the
 * button from its ISR, the timeouts from k_timer's ISR (they only
 * latch), the sensor's work items from the system workqueue, and the
 * LED controller from inside the sensor machine's hook. The user
 * button (alias sw0) is the emergency stop from any state and resumes
 * from emergency.
 *
 *   west build -t dot        (sensor_table with every feature, measuring_table, led_table)
 *   west fsm_liveview        (reads /dev/ttyACM0, graphs from build/)
 *
 * Copyright (c) 2026 Alexander Wachter
 *
 * SPDX-License-Identifier: Apache-2.0
 */

#include "led.hpp"
#include "sensor.hpp"

#include <mtl/Typelist.hpp>
#include <mtl/TypelistAlgorithms.hpp>
#include <mtl/zephyr/StateMachine.hpp>
#include <mtl/zephyr/TraceLogger.hpp>

#include <zephyr/drivers/gpio.h>
#include <zephyr/kernel.h>
#include <zephyr/logging/log.h>

#include <type_traits>

LOG_MODULE_REGISTER(sensor_sample, LOG_LEVEL_INF);

namespace {

// The queued machine is the one way in: a hook only ever sees the raw
// machine, for reading it. What the observers below have to report
// goes through these, defined next to the machine further down
void reportReading(int value);
void reportReadingFailed();
void reportCalibrated(int offset);

// --- virtual sensor ---------------------------------------------------------
// Entering reading starts a conversion: a hook of one state, the edge
// does not matter. Glue of this table's own module, so naming the state
// is fine here
class VirtualSensor {
public:
    VirtualSensor() { k_work_init_delayable(&work_, &VirtualSensor::finish); }

    template<typename STATE, typename MACHINE>
        requires std::is_same_v<STATE, sensor::reading>
    void onEnter(MACHINE&)
    {
        k_work_reschedule(&work_, K_MSEC(300));
    }

private:
    static void finish(k_work* work)
    {
        auto* self = CONTAINER_OF(k_work_delayable_from_work(work), VirtualSensor, work_);
        if (++self->conversions_ % 4 == 0) { // every fourth conversion fails
            LOG_INF("sensor: conversion failed");
            reportReadingFailed();
            return;
        }
        self->value_ = 35 + (self->value_ + 13) % 60; // a wandering value, 35..94
        LOG_INF("sensor: %d", self->value_);
        reportReading(self->value_);
    }

    k_work_delayable work_;
    int conversions_ = 0;
    int value_       = 0;
};

// --- calibration feature ----------------------------------------------------
// Declaring the feature's tag switches its states into the table
class Calibrator {
public:
    using enables = sensor::calibration_feature;

    Calibrator() { k_work_init_delayable(&work_, &Calibrator::finish); }

    // calibrating is the initial state: the construction-time entry is
    // the entry that starts the calibration
    template<typename STATE, typename MACHINE>
        requires std::is_same_v<STATE, sensor::calibrating>
    void onEnter(MACHINE&)
    {
        k_work_reschedule(&work_, K_MSEC(1500));
    }

private:
    static void finish(k_work*)
    {
        LOG_INF("calibrated: offset 3");
        reportCalibrated(3);
    }

    k_work_delayable work_;
};

// One workqueue thread for both machines, rather than one each (what
// the plain mtl::zephyr::StateMachine owns). Declared before the
// machines - the constructor starts the thread
mtl::zephyr::WorkQueue<2048, 5> fsm_queue{"sensor_fsm"};

// --- LED: a driver observer on the LED machine, the machine inside the
// observer of the sensor machine ---------------------------------------------
// Boards without led0 get the LED machine without its driver: the
// states still run (and trace), nothing is written
#define SAMPLE_HAS_LED DT_NODE_HAS_STATUS_OKAY(DT_ALIAS(led0))

#if SAMPLE_HAS_LED
struct LedDriver : fsm::observing<LedDriver> {
    template<typename STATE>
    static constexpr auto observe_static() -> decltype(STATE::lit)
    {
        return STATE::lit;
    }

    void notifyEntry(bool lit)
    {
        this->lit = lit;
        if (ready) {
            gpio_pin_set_dt(&pin, lit);
        }
    }

    // The machine is constructed before main() configures the pin:
    // remember the level until then
    void attach()
    {
        ready = gpio_is_ready_dt(&pin) && gpio_pin_configure_dt(&pin, GPIO_OUTPUT_INACTIVE) == 0;
        if (ready) {
            gpio_pin_set_dt(&pin, lit);
        } else {
            LOG_ERR("led0 not ready: LED states run unlit");
        }
    }

    gpio_dt_spec pin = GPIO_DT_SPEC_GET(DT_ALIAS(led0), gpios);
    bool ready       = false;
    bool lit         = false;
};
#endif

// Picks the led_pattern element of each state's annotation set by the
// overload's type alone; declaring the type makes the machine check
// that some state carries it
struct LedController : fsm::observing<LedController> {
    using observes = fsm::annotations<sensor::led_pattern>;

    // Called from inside the sensor machine's hook: the LED machine's
    // process() only queues, its own drain follows on the workqueue
    void notifyEntry(sensor::led_pattern kind) { stateMachine.process(led::pattern{kind}); }

    // observers before the state machine they are injected into. A
    // class member cannot deduce its template arguments, so they are
    // named; the machine brings its own timeout timer
    mtl::zephyr::TraceLogger tracer;
#if SAMPLE_HAS_LED
    LedDriver driver;
    mtl::zephyr::StateMachineOnSharedWorkqueue<led::led_table, LedDriver,
                                               mtl::zephyr::TraceLogger>
        stateMachine{mtl::zephyr::table<led::led_table>, fsm_queue, driver, tracer};
#else
    mtl::zephyr::StateMachineOnSharedWorkqueue<led::led_table, mtl::zephyr::TraceLogger>
        stateMachine{mtl::zephyr::table<led::led_table>, fsm_queue, tracer};
#endif
};

// --- alarm policy: answers the table's above_limit question -----------------
// The tag selects the overload; the forms are those of a static guard
// with the tag in front. The limit is runtime data of this object, so
// the behavior changes from outside the table
struct AlarmPolicy {
    // asked from measuring: the reading_done bubbled up from its submachine
    bool check(sensor::above_limit, sensor::measuring const&, sensor::reading_done const& event) const
    {
        return event.value > limit;
    }

    int limit = 75;
};

// --- sensor power rail: the other element of the same annotation sets;
// reading -> retrying changes the LED but not the rail, so only the LED
// is notified there
struct PowerRail : fsm::observing<PowerRail> {
    using observes = fsm::annotations<sensor::sensor_power>;

    void notifyEntry(sensor::sensor_power power)
    {
        LOG_INF("sensor power %s", power.on ? "on" : "off");
    }
};

// --- the sensor state machine -----------------------------------------------
// The machine keeps only the features its observers enable: without
// the calibrator, calibrating and its entries are gone from the table
// it runs. The machine brings its timeout timer and puts it first; the
// tracer goes last (its line follows the effects). Static: kernel
// objects and machine addresses must stay put
VirtualSensor sensor;
AlarmPolicy alarm_policy;
LedController leds;
PowerRail rail;
mtl::zephyr::TraceLogger tracer;
#ifdef CONFIG_SAMPLE_CALIBRATION
Calibrator cal;
mtl::zephyr::StateMachineOnSharedWorkqueue monitor{mtl::zephyr::table<sensor::sensor_table>,
                                                   fsm_queue, sensor, cal, alarm_policy, leds,
                                                   rail, tracer};
#else
mtl::zephyr::StateMachineOnSharedWorkqueue monitor{mtl::zephyr::table<sensor::sensor_table>,
                                                   fsm_queue, sensor, alarm_policy, leds, rail,
                                                   tracer};
#endif

// What the observers report, through the queue
void reportReading(int value)
{
    monitor.process(sensor::reading_done{value});
}

void reportReadingFailed()
{
    monitor.process(sensor::reading_failed{});
}

// without the calibration feature the table has no such event: ignored
void reportCalibrated(int offset)
{
    monitor.process(sensor::calibrated{offset});
}

// --- emergency button -------------------------------------------------------
// The ISR processes the event itself: process() only queues it
#if DT_NODE_HAS_STATUS_OKAY(DT_ALIAS(sw0))

constexpr int64_t debounce_ms = 200;
gpio_dt_spec const button = GPIO_DT_SPEC_GET(DT_ALIAS(sw0), gpios);
gpio_callback button_callback;
int64_t last_press = -debounce_ms;

void buttonIsr(device const*, gpio_callback*, uint32_t)
{
    auto const now = k_uptime_get();
    if (now - last_press < debounce_ms) {
        return;
    }
    last_press = now;
    monitor.process(sensor::button{});
}

int initButton()
{
    if (!gpio_is_ready_dt(&button)) {
        LOG_ERR("button port not ready");
        return -ENODEV;
    }
    int error = gpio_pin_configure_dt(&button, GPIO_INPUT);
    if (error == 0) {
        error = gpio_pin_interrupt_configure_dt(&button, GPIO_INT_EDGE_TO_ACTIVE);
    }
    if (error != 0) {
        LOG_ERR("button configuration failed: %d", error);
        return error;
    }
    gpio_init_callback(&button_callback, buttonIsr, BIT(button.pin));
    return gpio_add_callback(button.port, &button_callback);
}

#else

int initButton()
{
    LOG_WRN("no sw0 button on this board: no emergency stop");
    return 0;
}

#endif

} // namespace

int main()
{
#if SAMPLE_HAS_LED
    leds.driver.attach();
#else
    LOG_WRN("no led0 on this board: LED states run unlit");
#endif
    initButton();
    k_sleep(K_FOREVER);
    return 0;
}
```

## src/led.hpp
```c
/*
 * The LED's own state machine: off, on, or blinking through two timed
 * states. A pattern event carries the wanted pattern; guards on the
 * payload pick the target from any state. Free of Zephyr for the graph
 * generator.
 *
 * Copyright (c) 2026 Alexander Wachter
 *
 * SPDX-License-Identifier: Apache-2.0
 */

#pragma once

#include "sensor.hpp"

#include <mtl/StateMachine.hpp>

#include <chrono>

namespace led {

using namespace std::chrono_literals;

struct pattern {
    sensor::led_pattern kind;
};

// Each state's level, consumed by the led_driver observer
struct off {
    static constexpr bool lit = false;
};
struct on {
    static constexpr bool lit = true;
};
struct blink_on {
    static constexpr bool lit     = true;
    static constexpr auto timeout = 150ms;
};
struct blink_off {
    static constexpr bool lit     = false;
    static constexpr auto timeout = 150ms;
};

// Guard on the event payload, from whichever state (the templated form
// is validated against any_state, the wildcard's source)
template<sensor::led_pattern KIND>
struct wants {
    static bool check(auto const&, pattern const& event) { return event.kind == KIND; }
};

struct led_table : fsm::transition_table<
    fsm::initial<off>,
    fsm::transition<fsm::from<fsm::any_state>, fsm::on<pattern>, fsm::to<off>,
                    fsm::guard<wants<sensor::led_pattern::off>>>,
    fsm::transition<fsm::from<fsm::any_state>, fsm::on<pattern>, fsm::to<on>,
                    fsm::guard<wants<sensor::led_pattern::on>>>,
    fsm::transition<fsm::from<fsm::any_state>, fsm::on<pattern>, fsm::to<blink_on>>,
    fsm::transition<fsm::from<blink_on>,  fsm::on<fsm::timeout>, fsm::to<blink_off>>,
    fsm::transition<fsm::from<blink_off>, fsm::on<fsm::timeout>, fsm::to<blink_on>>> {};

} // namespace led
```

## src/sensor.hpp
```c
/*
 * The sensor monitor's events, states and tables - free of Zephyr so
 * the host-built graph generator (west build -t dot) can include them.
 *
 * A reading is started by entering the reading state (the virtual
 * sensor observer starts it) and answered with reading_done{value} or
 * reading_failed. The retry loop is a composite state: measuring owns
 * a submachine of reading and retrying, failures are retried there up
 * to a budget kept in the submachine's context (fresh on every entry
 * of measuring), and what the submachine does not handle - a finished
 * reading, a failure once the retries are used up, the overall time
 * budget - is measuring's own transition. A value above the limit takes
 * the alarm branch. The button is an emergency stop from every state.
 *
 * The calibration at start is a feature: its state declares
 * `using feature = calibration_feature;`, and only an injected observer
 * declaring `using enables = calibration_feature;` switches it on -
 * otherwise the feature's states and every entry touching them are
 * filtered out of the table at compile time.
 *
 * Copyright (c) 2026 Alexander Wachter
 *
 * SPDX-License-Identifier: Apache-2.0
 */

#pragma once

#include <mtl/StateMachine.hpp>
#include <mtl/Typelist.hpp>
#include <mtl/TypelistAlgorithms.hpp>

#include <chrono>
#include <type_traits>

namespace sensor {

using namespace std::chrono_literals;

// --- the feature tag: declared by its states and by the enabling observer
struct calibration_feature {};

// --- events -----------------------------------------------------------------
struct reading_done {
    int value;
};
struct reading_failed {};
struct calibrated {
    int offset;
};
struct button {};

// --- per-state annotations, observed by type: the LED pattern (the
// LedController observer) and the sensor's power rail (PowerRail)
enum class led_pattern { off, on, blink };

struct sensor_power {
    bool on;
    constexpr bool operator==(sensor_power const&) const = default;
};

// --- machine-owned context: survives transitions, one instance per type
struct retry_budget {
    int failures = 0;
};
struct stop_log {
    int readings_ignored = 0;
};

// --- states -----------------------------------------------------------------
struct idle {
    static constexpr auto timeout = 1000ms;
    static constexpr auto annotations = fsm::annotate(led_pattern::off, sensor_power{false});
};

// Feature state: in the table only with an observer enabling the
// feature, which answers with calibrated{offset}; the timeout is the
// fallback
struct calibrating {
    using feature = calibration_feature;

    static constexpr auto timeout = 3000ms;
    static constexpr auto annotations = fsm::annotate(led_pattern::on, sensor_power{true});
};

// The sub-states of measuring: they annotate the LED, which changes
// between them, while the sensor's power rail - on for the whole
// measurement - is measuring's own annotation. An annotation type lives
// on one level of the hierarchy
struct reading {
    static constexpr auto timeout = 2000ms; // the sensor never answered
    static constexpr auto annotations = fsm::annotate(led_pattern::on);

    using contexts = fsm::contexts<retry_budget>;
    retry_budget& context;
    explicit reading(retry_budget& budget) : context(budget) {}
};

struct retrying {
    static constexpr auto timeout = 200ms;
    static constexpr auto annotations = fsm::annotate(led_pattern::off);

    using contexts = fsm::contexts<retry_budget>;
    retry_budget& context;
    // one more attempt used, whether the sensor reported the failure or
    // never answered (the timeout path constructs without the event)
    retrying(reading_failed const&, retry_budget& budget) : retrying(budget) {}
    explicit retrying(retry_budget& budget) : context(budget) { ++context.failures; }
};

struct alarm {
    static constexpr auto timeout = 2000ms;
    static constexpr auto annotations = fsm::annotate(led_pattern::blink, sensor_power{false});

    int value = 0;
    alarm() = default;
    explicit alarm(reading_done const& event) : value(event.value) {} // payload delivery
};

struct failed {
    static constexpr auto timeout = 3000ms;
    static constexpr auto annotations = fsm::annotate(led_pattern::blink, sensor_power{false});
};

struct emergency {
    static constexpr auto annotations = fsm::annotate(led_pattern::on, sensor_power{false});

    using contexts = fsm::contexts<stop_log>;
    stop_log& context;
    explicit emergency(stop_log& log) : context(log) {}
    // a reading finishing while stopped is handled in place
    void handle(reading_done const&) { ++context.readings_ignored; }
    void handle(reading_failed const&) { ++context.readings_ignored; }
};

// --- guards -----------------------------------------------------------------
// A question the table asks, answered by an object injected into the
// machine (AlarmPolicy in main.cpp holds the limit): the table decides
// where the question is asked, not what the answer depends on
struct above_limit {};

// A guard answering itself: static, needs no injection
struct retries_left {
    static constexpr int max_retries = 3;
    static bool check(reading const& state) { return state.context.failures < max_retries; }
};

// --- the retry loop: the submachine of measuring ----------------------------
// Every row here is the submachine's own business; a reading_done, or a
// reading_failed once the guard refuses, is not handled here and falls
// through to measuring's rows in the parent table. The timeouts run on
// the second timer slot, next to measuring's budget on the first
struct measuring_table : fsm::transition_table<
    fsm::transition<fsm::from<reading>,  fsm::on<reading_failed>, fsm::to<retrying>,
                    fsm::guard<retries_left>>,
    fsm::transition<fsm::from<reading>,  fsm::on<fsm::timeout>,   fsm::to<retrying>>,
    fsm::transition<fsm::from<retrying>, fsm::on<fsm::timeout>,   fsm::to<reading>>> {};

// The composite state: constructed with a fresh submachine (and a fresh
// retry_budget - the submachine's context) on every entry, its timeout
// the budget for the whole loop
struct measuring {
    using submachine = measuring_table;
    static constexpr auto timeout     = 6000ms;
    static constexpr auto annotations = fsm::annotate(sensor_power{true});
};

// --- the table: its transitions, features included; a disabled feature
// is filtered out. Without the calibration entries the first
// transition's source, idle, is the initial state
using sensor_transitions = fsm::transition_table<
    fsm::initial<calibrating>,
    fsm::transition<fsm::from<calibrating>, fsm::on<calibrated>,   fsm::to<idle>>,
    fsm::transition<fsm::from<calibrating>, fsm::on<fsm::timeout>, fsm::to<failed>>,
    fsm::transition<fsm::from<idle>,      fsm::on<fsm::timeout>,   fsm::to<measuring>>,
    fsm::transition<fsm::from<measuring>, fsm::on<reading_done>,   fsm::to<alarm>,
                    fsm::guard<above_limit>>,
    fsm::transition<fsm::from<measuring>, fsm::on<reading_done>,   fsm::to<idle>>,
    fsm::transition<fsm::from<measuring>, fsm::on<reading_failed>, fsm::to<failed>>, // retries used up
    fsm::transition<fsm::from<measuring>, fsm::on<fsm::timeout>,   fsm::to<failed>>, // the budget
    fsm::transition<fsm::from<alarm>,     fsm::on<fsm::timeout>,   fsm::to<idle>>,
    fsm::transition<fsm::from<failed>,    fsm::on<fsm::timeout>,   fsm::to<idle>>,
    fsm::transition<fsm::from<fsm::any_state>, fsm::on<button>,    fsm::to<emergency>>,
    fsm::transition<fsm::from<emergency>, fsm::on<button>,         fsm::to<idle>>,
    fsm::internal_transition<fsm::from<emergency>, fsm::on<reading_done>>,
    fsm::internal_transition<fsm::from<emergency>, fsm::on<reading_failed>>>;

// The table, features included: the machine built on it removes every
// feature none of its observers enables, at every level. A machine
// runs a named table - a struct, not the alias above: the short name,
// sensor_table, identifies the machine in trace lines and graphs
struct sensor_table : sensor_transitions {};

// A stand-in observer enabling every feature, for the checks below
// (the real enabler lives with the board code)
struct every_feature {
    using enables = calibration_feature;
};

// what a machine runs: with the calibrator, the table as named; without
// an enabler, the table minus the feature, idle leading
using with_calibration    = fsm::enabled_table_t<sensor_table, fsm::observers<every_feature>>;
using without_calibration = fsm::enabled_table_t<sensor_table, fsm::observers<>>;
static_assert(std::is_same_v<with_calibration, sensor_table>);
static_assert(std::is_same_v<mtl::front_t<with_calibration::states>, calibrating>);
static_assert(std::is_same_v<mtl::front_t<without_calibration::states>, idle>);
static_assert(!mtl::has_a_v<without_calibration::states, calibrating>);
// two machine levels: the facade brings two timers
static_assert(fsm::levels_v<sensor_table> == 2);
static_assert(std::is_same_v<fsm::nested_tables_t<sensor_table>,
                             mtl::typelist<sensor_table, measuring_table>>);

} // namespace sensor
```
